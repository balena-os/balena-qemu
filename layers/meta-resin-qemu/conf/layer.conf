## layers/meta-resin-qemu/conf/layer.conf
```bitbake
BBPATH .= ":${LAYERDIR}"

BBFILES += "${LAYERDIR}/recipes-*/*/*.bb \
            ${LAYERDIR}/recipes-*/*/*.bbappend"

BBFILE_COLLECTIONS += "resin-qemu"
BBFILE_PATTERN_resin-qemu := "^${LAYERDIR}/"
BBFILE_PRIORITY_resin-qemu = "1337"
```

## layers/meta-resin-qemu/conf/machine/docker-x86-64.conf
```bitbake
#@TYPE: Machine
#@NAME: Docker x86-64
#@DESCRIPTION: Machine configuration for the Docker x86-64

include conf/machine/qemux86-64.conf
PREFERRED_PROVIDER_virtual/kernel_forcevariable = "linux-dummy"
INITRAMFS_IMAGE_BUNDLE = "0"
```
